## main/Kconfig.projbuild
```kconfig
menu "WiFi Configuration"

    config ESP_WIFI_SSID
        string "WiFi SSID"
        default "MYOUR_WIFI_SSID"
        help
            Enter your WiFi SSID here.

    config ESP_WIFI_PASSWORD
        string "WiFi Password"
        default "YOUR_WIFI_PASSWORD"
        help
            Enter your WiFi Password here.

endmenu
```
